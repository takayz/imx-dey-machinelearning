## conf/layer.conf
```bitbake
# We have a conf and classes directory, add to BBPATH
BBPATH .= ":${LAYERDIR}"

# We have recipes-* directories, add to BBFILES
BBFILES += "${LAYERDIR}/recipes-*/*/*.bb \
            ${LAYERDIR}/recipes-*/*/*.bbappend"

BBFILE_COLLECTIONS += "meta-dey-machinelearning"
BBFILE_PATTERN_meta-dey-machinelearning = "^${LAYERDIR}/"
BBFILE_PRIORITY_meta-dey-machinelearning = "6"

LAYERDEPENDS_meta-dey-machinelearning = "core"
LAYERSERIES_COMPAT_meta-dey-machinelearning = "thud"
```
